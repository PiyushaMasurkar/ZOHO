## build/conf/local.conf
```bitbake
MACHINE ??= "raspberrypi4-64"

BB_NUMBER_THREADS = "4"
PARALLEL_MAKE = "-j 4"

LICENSE_FLAGS_ACCEPTED += "synaptics-killswitch"

INHERIT += "rm_work"
INHIBIT_PACKAGE_DEBUG_SPLIT = "1"
PACKAGE_DEBUG_SPLIT_STYLE = "debug-without-src"

BB_DISKMON_DIRS = "\
    STOPTASKS,${TMPDIR},2G,100K \
    STOPTASKS,${DL_DIR},2G,100K \
    STOPTASKS,${SSTATE_DIR},2G,100K \
    HALT,${TMPDIR},1G,1K \
    HALT,${DL_DIR},1G,1K \
    HALT,${SSTATE_DIR},1G,1K"

ENABLE_I2C = "1"
IMAGE_INSTALL:append = " i2c-tools"

EXTRA_IMAGE_FEATURES += "ssh-server-openssh"
ENABLE_UART = "1"EXTRA_IMAGE_FEATURES += "debug-tweaks ssh-server-openssh"
ENABLE_UART = "1"
```
